       PAGE
*
*  THIS MODULE IS INCLUDED IN SOURCE MODULES
*  BY USING A 'COPY' DIRECTIVE.
*
*
***************
*
*  CRU DEFINITIONS
*
***************
PIO    EQU  >0000             PARALLEL I/O
*  PARALLEL I/O - READ BITS
KDS    EQU  PIO+0             KEYBOARD DATA STROBE
*      EQU  PIO+1             UNUSED
D1$SIZ EQU  PIO+2             DS01 SIZE (1=8",0=5.25")
D1$DEN EQU  PIO+3             DS01 DENSITY (0=SD,1=DD)
FDCINT EQU  PIO+4             FDC INTERRUPT-
KBDINT EQU  PIO+5             KBD INTERRUPT-
VDPINT EQU  PIO+6             VDP INTERRUPT-
BUSINT EQU  PIO+7             BUS INTERRUPT-
KEYBRD EQU  PIO+8             KEYBOARD  DATA (8 BITS)
*  PARALLEL I/O - WRITE BITS
CLKLED EQU  PIO+0             CLOCK LED
KBDACK EQU  PIO+1             KEYBOARD ACKNOLEDGE-
BUSACK EQU  PIO+2             BUS INTERRUPT RESET-
BTENBL EQU  PIO+3             BUS TIMEOUT FLAG ENABLE
DRVSIZ EQU  PIO+4             DRIVE SIZE (1=8",0=5.25")
ROMON  EQU  PIO+5             0=ROM ON,1=ROM OFF
BELLON EQU  PIO+6             BELL ENABLE BIT
*      EQU  PIO+7             UNUSED
*
*      EQU  >0020             UNUSED
EIA02  EQU  >0040             PRINTER HARDWARE BASE ADDRESS
*      EQU  >0060             UNUSED
*      EQU  >0080             UNUSED
*      EQU  >00A0             UNUSED
CASS02 EQU  >00C0             CASSETTE HARDWARE BASE ADDRESS
DMAC   EQU  >00E0             DMAC HARDWARE BASE ADDRESS
*
*  RESERVED OFF-BOARD CRU LOCATIONS
PRMPOP EQU  >200              PROM PROGRAMMER BOARD
* READ BITS
*      EQU  PRMPOP+0
*      EQU  PRMPOP+1
*      EQU  PRMPOP+2
*      EQU  PRMPOP+3
PRORDY EQU  PRMPOP+4
PGM    EQU  PRMPOP+5
PGMPUL EQU  PRMPOP+6          * TEST
V30    EQU  PRMPOP+7
EDATA  EQU  PRMPOP+8
* WRITE BITS
PRORST EQU  PRMPOP+0
EPTYPE EQU  PRMPOP+1
VCCON  EQU  PRMPOP+4
*PGM   EQU  PRMPOP+5
PROERR EQU  PRMPOP+6
*      EQU  PRMPOP+7
*EDATA EQU  PRMPOP+8
EPADR  EQU  PRMPOP+16
*
*   CENTRONICS PARALLEL PRINTER PORT
*
*  BIT      0    1    2    3    4    5    6    7    8    9
*  READ                                                 BUSY
*  WRITE   D7   D6   D5   D4   D3   D2   D1   D0   DS
*            (LSB)                           (MSB)
*
PPRINT EQU  >400
*                                            +--+
PPDS   EQU  PPRINT+8          DATA STROBE ___|  |__________   
*
*                                             +----------+
PPBUSY EQU  PPRINT+9          BUSY        ____|          |__
*
***************
*
*  MEMORY MAPPED I/O DEFINITIONS
*
***************
MAPPER EQU  >F100             MEMORY MAPPER LOCATION
M$REG0 EQU  MAPPER+0          MAPPER REGISTERS 0..15
M$REG1 EQU  MAPPER+2
M$REG2 EQU  MAPPER+4
M$REG3 EQU  MAPPER+6
M$REG4 EQU  MAPPER+8
M$REG5 EQU  MAPPER+10
M$REG6 EQU  MAPPER+12
M$REG7 EQU  MAPPER+14
M$REG8 EQU  MAPPER+16
M$REG9 EQU  MAPPER+18
M$REGA EQU  MAPPER+20
M$REGB EQU  MAPPER+22
M$REGC EQU  MAPPER+24
M$REGD EQU  MAPPER+26
M$REGE EQU  MAPPER+28
M$REGF EQU  MAPPER+30
*
VDP    EQU  >F120
VRAM   EQU  VDP+0             VDP VRAM ACCESS ADDRESS
VDPREG EQU  VDP+1             VDP REGISTER ACCESS ADDRESS
*
* TEXT / GRAPHICS 1 MODE STORAGE
NTBA   EQU  >400              NAME TABLE
CTBA   EQU  >700              COLOUR TABLE
PGBA   EQU  >800              PATTERN GENERATOR TABLE
SNTBA  EQU  >780              SPRITE NAME TABLE
SPGBA  EQU  >000              SPRITE PATTERN GENERATOR TBL.
* GRAPHICS 2 MODE STORAGE
NTBA1  EQU  >1800             NAME TABLE
CTBA1  EQU  >2000             COLOUR TABLE
PGTBA1 EQU  >0000             PATTERN GENERATOR TABLE
SNTBA1 EQU  >1B00             SPRITE NAME TABLE
SPGBA1 EQU  >3800             SPRITE PATTERN GENERATOR TBL.
*
FDC    EQU  >F140             TMS9909 FLOPPY DISC CONTROLLER
*
