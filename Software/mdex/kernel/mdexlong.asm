.
.                                       Disassembly tool by  Peter Buro 1985
.                                       Version 1.0  851124
.
          idt       "MDEX"
          copy      "../systemdef/jsys$"
.
.         Cannot copy sysdef, so repeat driver defs here
.
r$        equ       1                   read
w$        equ       2                   write
init$     equ       080                 initialise device

.
. ********************************************************************
. *                       BOOT & STARTUP CODE                        *
. ********************************************************************
.
          dstk      r10                 assign r10 as stack pointer

mdex      b         mstart
          b         mdboot
.
mstart    lwpi      wp1                 get us a nice workspace
          li        r0,00080            fill up first 256 bytes (0-0ff)
          li        r1,mdex             point to start of mdex
          clr       r2                  point to start of address space (=0)
tbcopy    mov       *r1+,*r2+           move it there
          dec       r0                  any more to copy
.
          jne       tbcopy              yes, once again
          clr       r0                  point to reset wp location
          mov       mstart+2,*r0+       exchange "b" with wp1
          b         mdboot              go and boot rest of system
.
          rorg      00030
.
          data      mdboot
          data      0100
          data      STDWS               standard user workspace
          data      DIRTRA              starting track of file directory
          data      DIRSEC              starting sector of file directory
          data      DSKSIZ              # of standard blocks found on disc
.
          rorg      00044
.
          data      wp2
          data      jysxop              xop1 JSYS
          data      wp1
          data      fltxop              xop2 FLOP
.
          rorg      00080
.
          b         bget
          b         bgeta
          b         brel
          b         edit$
          b         editx$
          b         editr$
          b         echar$
          b         eskip$
          b         ecol$
          b         ecoln$
          b         ecopy$
          b         emsg$
          bss       16
          b         emsgr$
          b         emsg1$
          b         ehexf$
          b         ehexv$
          b         edecf$
          b         edecv$
          b         insrt
          b         push
          b         remov
          b         initq
          b         bexp
.
          rorg      00100
.
mdboot    lwpi      wp1                 make sure we have a wp
          istk      stack               init stack
.
          li        r0,STDWS            have we specified a user wp
          jne       uswp                yes 
          li        r0,userws           no, make one
uswp      mov       r0,00034            move into table at start
.
          bl        TRESET              reset terminal
.
          clr       dsknum              clear disc number, start with drive 0
dskini    li        r1,init$            init function
          mov       dsknum,r8           get disc number
          a         r8,r8               make word bound (table)
          mov       dsktbl(r8),r8       set r8 to disc table
          bl        PIOPSF              init drive
          inc       dsknum              increment disc num
          mov       dsknum,r0
          ci        r0,2                have we done all discs
          jl        dskini              no, do another
.
          li        r1,init$            init function
          li        r8,UT$PR1           r8 points to printer table
          bl        PIOPRT              init printer
.
          li        r0,do$brk           set up default ^C handler
          mov       r0,intvec
          clr       cstogg
.
          li        r0,verstr           space for user version string
          li        r1,SYSVER           users ver string
cpyver    movb      *r1,*r0+
          cb        *r1+,endver		terminator char is ')'
          jne       cpyver
          li        r1,bootstr
          s         r1,r0               length of message
          bl        prtstr              print string
          b         cmdscn              go to command scan
.
bootstr   byte      0D
          text      "Marinchip Disc Executive (Ver. "
verstr    bss       10
endver    text      ")"
formfd    byte      0C
shuh      text      "Huh?"
sioerr    text      "Disc I/O error."
snoexe    text      "File isn''t executable."
serrat    text      " at &"
serrR0    text      "R0-R7: &"
serrR8    text      "R8-R15:&"
sejsys    text      "Unknown JSYS&"
sealgn    text      "Disc I/O must be on sector boundary.  Call&"
seterm    text      "Terminated by ^C&"
sestat    text      "Termination status &"
          even
.
. ********************************************************************
. *                       MAIN COMMAND LOOP                          *
. ********************************************************************
.

cmdscn*   limi      0
          istk      stack               (re-)init stack pointer
.
          clr       in$pgm              no user program is running
          clr       is$raw              clear console raw mode
          li        r0,02E7F            prompt '.' + <eoo>
          mov       r0,outbuf           copy to output buffer
          bl        rdline              type prompt & get line
lbl086    mov       r6,savlen
          mov       r7,savbuf
          bl        getpath             parse cmd line for command
          data      cmdscn              -> empty line
          data      prthuh              -> bad disk number
.
jlb00B    mov       r6,prmlen           save line len
          li        r1,params           copy rest of line to params buffer
          mov       r1,prmptr           save ptr to params buffer
jlb005    dec       r6
          jlt       jlb004
          movb      *r7+,*r1+
          jmp       jlb005

jlb004    mov       prmptr,r7           reset input buffer
          mov       prmlen,r6           reset line len
          mov       dsknum,r0           get disc number
          jlt       jlb006              none specified, check internal first

jlb012    bl        srchdir             look for command in directory
          data      prthuh              well we did not find it

          bl        rd$sec              go and read the first sector
          li        r0,7                
          li        r1,secbuf           
          li        r2,pgmhdr           fill program header (14 bytes)
jlb007    mov       *r1+,*r2+           
          dec       r0                  
          jne       jlb007              

          bl        nxttrk              increase sector number
          c         secbuf,marker       is it an ordinary executable file?
          jeq       jlb008              yes -> load it
          c         secbuf+8,pmagic     no, maybe it is a pascal file?
          jeq       pascfile            yes -> load pasc$.obj
          b         isnoexe             no, file is not executable
.
. pascal runtime loader
.
pascfile  li        r2,pasobj           name of pascal runtime, PASC$.OBJ
jlb013    mov       savbuf,r7
          mov       savlen,r6
          li        r0,6                copy name of runtime to filename
          li        r1,filnam
jlb00A    mov       *r2+,*r1+
          dec       r0
          jne       jlb00A
          clr       dsknum              seek on disk 0
          jmp       jlb00B              find and load it
.
. executable program loader
.
jlb008    mov       curtrk,r2           load track
          mov       cursec,r4           load sector
          mov       pgmld,r5            load address
          mov       pgmlen,r6           load length
          ai        r6,0007F            round length up to full sector
          andi      r6,0FF80
          li        r1,r$
          bl        lbl045
          bl        PIOPSF              do disk read
          mov       r1,r1               check status
          jeq       jlb00C              -> ok
          b         lbl046

jlb00C    li        r0,07F00            jump to program
          mov       r0,outbuf
          seto      in$pgm              set 'user program is running' flag
          clr       trapFCB             reset trap vector
          clr       maxfd               open file counter?
          mov       pgm$wp,r0           WP given in pgm header?
          jne       jlb00D
          mov       00034,pgm$wp        no -> use default WP
jlb00D    blwp      pgm$wp              START USER PROGRAM
.
. check internal command
.
jlb006    clr       dsknum              check internal command
          li        r1,11               number of internal commands
          li        r2,lbl04A           point to start of table

jlb011    li        r3,filnam           compare with file name
          mov       r2,r4               save pointer
          li        r5,6                12 char strings
jlb00F    c         *r3+,*r4+
          jne       jlb00E
          dec       r5
          jne       jlb00F

          mov       *r4+,r11            get command routine
          jeq       jlb010
          rt

jlb00E    ai        r2,14               next entry
          dec       r1                  still valid?
          jne       jlb011              yes -> check next entry            
          jmp       jlb012              no -> check external command

jlb010    li        r2,sh$nam           program is SHELL$.OBJ
          jmp       jlb013              load and run that
.
isnoexe   li        r0,22               length of message
          li        r1,snoexe           point to "file is not exe ..."
          jmp       jlb014
.
prthuh    li        r0,4                length of message
          li        r1,shuh             point to "Huh!"
jlb014    bl        prtstr              print message
          b         cmdscn              go and get next command
.
lbl04A    text      "BCOPY       "      internal command table
          data      00000               zero means: use SHELL$.OBJ
          text      "CRE         "      
          data      00000
          text      "CREATE      "
          data      00000
          text      "DEBUG       "
          data      do$dbg
          text      "DEL         "
          data      00000
          text      "DELETE      "
          data      00000
          text      "DIR         "
          data      00000
          text      "DIRECT      "
          data      00000
          text      "PREP        "
          data      00000
          text      "RENAME      "
          data      00000
          text      "JUMP        "
          data      do$jmp
.
lbl052    pshr      r11
          mov       r3,r3               at least one digit seen?
          jeq       jlb015              no -> print Huh?
          bl        getchr              next char
          jlt       jlb015              eol? -> Huh?
          ci        r0,','              is it ','?
          jne       jlb015              no -> Huh?
          popj
.
jlb015    popr      r11
          b         prthuh
.
do$jmp    bl        gethex              get hex number
          bl        lbl052              check comma
          mov       r1,pgm$wp
          bl        gethex              get 2nd hex number
          mov       r1,pgm$pc
          b         jlb00C              jump to programme

do$dbg    li        r0,DBGROM           do we have a debug rom installed?
          jeq       jlb016              no ->
          blwp      DBGROM              jump to debug rom
jlb016    b         jlb012              -> look for external debug pgm
.
.
. ********************************************************************
. *                     JSYS SYSTEM CALL HANDLER                     *
. ********************************************************************
.
.         Structure of the file table
.
filtrk    equ       0                   first track
filsec    equ       2                   first sector
fillen    equ       4                   file length in sectors
filofs    equ       6                   file offset (in sectors?)
fildsk    equ       8                   file disk


jysxop    limi      0                   setup JSYS env
          li        r10,stack

          mov       r11,savFCB          save FCB ptr
          movb      *r11,r1             get command byte
          srl       r1,8

          li        r0,0D               find command
          li        r2,lbl055
jlb018    c         r1,*r2+
          jeq       jlb017
          inct      r2
          dec       r0
          jne       jlb018

          li        r2,sejsys           text "Unkonwn JSYS"     
          b         abort               print error & resume command loop

jlb017    mov       *r2,r2              jump to JSYS routine
          b         *r2

lbl055    data      read$
          data      rdwr
          data      write$
          data      rdwr
          data      open$
          data      open
          data      create$
          data      open                create is alias for open in MDEX
          data      close$
          data      close
          data      delete$
          data      delete
          data      seek$
          data      seek
          data      trap$
          data      trap
          data      mem$
          data      mem
          data      ioctl$
          data      ioctl
          data      exec$
          data      exec
          data      time$
          data      time
          data      exit$
          data      exit
.
. EXIT
.
exit      mov       2(r11),r6           get exit code
          jeq       jlb019              zero? -> done
          clr       in$pgm              clear 'user program is running' flag
          li        r0,edtpkt           get edit packet
          bl        EDIT$
          li        r0,sestat           print "Termination status "
          bl        EMSG$
          mov       r6,r0
          bl        EHEXV$              print exit code in hex
          b         lbl065              print registers

jlb019    lwpi      wp1                 resume command loop
          b         cmdscn
.
. OPEN / CREATE
.
open      mov       2(r11),r6           get name length
          srl       r6,8
          mov       4(r11),r7           get file pointer
          mov       maxfd,r0            get next handle
          ci        r0,10               handle = 10?
          jl        jlb01A              no ->
          li        r1,ft$trk           search for free slot in file table
jlb01B    mov       filsec(r1),r2
          jeq       jlb01A
          ai        r1,10
          dec       r0
          jne       jlb01B
          jmp       jlb01C              error: too many files

jlb01A    bl        getpath             get path
          data      lbl067              -> empty line
          data      lbl067              -> bad disk number
          bl        getdsk              prep disk number
          mov       dsknum,r0
          jne       jlb01D              
          bl        ckspcl              check special device
          data      fdspcl              -> special fd found
jlb01D    bl        srchdir             check for file in directory
          data      lbl06B              -> not found

. find available slot in open file table
.
jlb022    clr       r2                  find first available file slot
          li        r4,ft$trk
          mov       maxfd,r0
jlb020    inc       r2
          dec       r0
          jlt       jlb01E              -> no closed slot, use new
          mov       filsec(r4),r3
          jeq       jlb01F              -> closed slot found, reuse
          ai        r4,10
          jmp       jlb020
jlb01E    inc       maxfd               increase max handle

. fill file table block with start, length, etc
.
jlb01F    mov       curtrk,filtrk(r4)   set beginning trk/sec
          mov       cursec,filsec(r4)
          mov       14(r1),fillen(r4)   set file length
          clr       filofs(r4)          file offset := 0
          mov       dsknum,fildsk(r4)
jlb021    mov       savFCB,r11          refetch FCB
          movb      zerob,1(r11)        status = ok
          swpb      r2                  set return fd
          movb      r2,3(r11)
          rtwp

fdspcl    ci        r2,0F0              fd < DISC$1 ?
          jl        jlb021              -> yes, just return special fd
          ci        r2,0F2              fd > DISC$2 ?
          jhe       jlb021              -> yes, just return special fd

. set file to "starting at track 0, sector 1 and size to disk size"
.
          clr       curtrk              set track zero
          mov       one,cursec          set sector one
          andi      r2,0F
          mov       r2,dsknum
          mov       0003A,r0            get disk size
          mpy       DSK$DF,r0           multiply by disk factor (1..4)
          mov       r1,secbuf+14        place in secbuf[14]
          li        r1,secbuf
          jmp       jlb022

lbl06B    mov       savFCB,r11
          movb      stat$3,1(r11)       reject with status 3 (file not found)
          rtwp

jlb01C    movb      stat$8,1(r11)       reject with status 8 (too many files)
          rtwp

lbl067    mov       savFCB,r11
          movb      stat$5,1(r11)       reject with status 5 (bad name)
          rtwp
.
. CLOSE
.
close     movb      3(r11),r0           get fd
          srl       r0,8
          bl        is$dev              special device fd ?
          data      lbl073              -> yes

          mov       savFCB,r11          restore FCB ptr
          c         r0,maxfd            larger than maxfd?
          jh        jlb023              -> error

          mov       r0,r2
          dec       r0                  find entry
          mpy       ftesiz,r0           multiple by entry size, result in r1
          mov       ft$sec(r1),r0       get first sector
          jeq       jlb023              empty? -> yes
          clr       ft$sec(r1)          close

. reduce maxfd if possible
.
          c         r2,maxfd            was highest fd?
          jne       jlb024              no ->
jlb025    dec       maxfd               reduce max handle
          jeq       jlb024              more to test? -> no
          ai        r1,-10              previous slot
          mov       ft$sec(r1),r0       also empty ?
          jeq       jlb025              yes -> reduce maxfd further

jlb024    movb      zerob,1(r11)        return with status = ok
          rtwp

jlb023    movb      stat$4,1(r11)       reject with status 4 (not open)
          rtwp

. close special device
.
lbl073    ci        r0,0FE              was it printer?
          jne       jlb026              -> no

          li        r1,w$
          li        r5,formfd           FF
          li        r6,1                len = 1 char
          li        r8,UT$PR1           printer device data
          bl        PIOPRT              eject page

jlb026    mov       savFCB,r11          restore FCB and return OK
          jmp       jlb024
.
. DELETE
.
delete    mov       2(r11),r6           get name length
          srl       r6,8
          mov       4(r11),r7           get name ptr
          bl        getpath             parse path
          data      lbl067              -> empty
          data      lbl067              -> bad dsknum

          bl        getdsk              get disk number
          bl        srchdir             lookup file in directory
          data      lbl06B              -> not found

          mov       r2,curtrk
          mov       r3,cursec
          mov       maxfd,r3            any files open?
          jeq       jlb027              no -> no need to close

          li        r2,ft$trk           look up file by its location
jlb029    c         curtrk,filtrk(r2)
          jne       jlb028
          c         cursec,filsec(r2)
          jne       jlb028
          c         dsknum,fildsk(r2)
          jne       jlb028
          clr       cursec(r2)          cursec ?????? should be filsec
jlb028    ai        r2,10               next entry
          dec       r3
          jne       jlb029

jlb027    clr       *r1                 erase from directory 
          bl        wr$sec              write directory sector back to disk
          mov       savFCB,r11          restore FCB ptr
          movb      zerob,1(r11)        set status = ok
          rtwp
.
. READ & WRITE
.
rdwr      movb      3(r11),r0           get fd
          clr       8(r11)              set FCB zero bytes transferred
          srl       r0,8
          jeq       rwcons              console? -> yes
          ci        r0,0FE              printer?
          jne       jlb02B
          b         rwprnt              -> yes

jlb02B    ci        r0,0FF              params?
          jne       jlb02C
          b         rwpara              -> yes

jlb02C    ci        r0,10               fd > 10?
          jh        jlb02D              yes -> status 4
          dec       r0                  find file block
          mpy       ftesiz,r0
          mov       ft$sec(r1),r2       get 1st sector
          jeq       jlb02D              not open ? -> status 4

          mov       6(r11),r0           get buffer length
          mov       r0,r6
          andi      r0,07F              round number of sectors?
          jne       jlb02E              no -> report and abort (!)

          mov       ft$ofs(r1),r7       get file offset
          c         r7,ft$len(r1)       offset >= len?
          jhe       jlb02F              yes -> report eof

          mov       r6,r0               convert length to sectors
          srl       r0,7
          a         r0,ft$ofs(r1)       add to offset
jlb031    c         ft$ofs(r1),ft$len(r1)       new offset > len?
          jle       jlb030              -> no
          dec       ft$ofs(r1)          reduce length to available
          ai        r6,-128
          jmp       jlb031

jlb030    mov       ft$trk(r1),r0       get track
          a         r7,r2               add offset to 1st sector
jlb033    ci        r2,27               more than one track?
          jl        jlb032              no ->
          ai        r2,0FFE6            sec := sec - 26
          inc       r0                  trk := trk + 1
          jmp       jlb033

jlb032    mov       r2,r4               set call, sec to r4
          mov       r0,r2               trk to r2
          mov       4(r11),r5           buf to r5
          mov       r6,8(r11)           len is in r6, store to xferred
          mov       ft$dsk(r1),r8       disk device block to r8
          a         r8,r8
          mov       dsktbl(r8),r8
          li        r1,r$               set r$
          movb      *r11,r0             refetch operation
          srl       r0,8
          ci        r0,read$            was cmd a read$ ?
          jeq       jlb034              yes ->

. write disk sector
.
          li        r1,w$               set w$
jlb034    bl        PIOPSF              call driver
          mov       savFCB,r11          restore FCB ptr
          ci        r1,3                past end of disk?
          jeq       jlb035              reject with status 1
          mov       r1,r1               I/O error?
          jne       jlb036              yes ->
          movb      zerob,1(r11)        set status = ok
          rtwp

jlb035    clr       8(r11)              no bytes transferred
jlb02F    movb      oneb,1(r11)         reject with status 1 (eof reached)
          rtwp

jlb036    movb      stat$2,1(r11)       reject with status 2 (I/O error)
          rtwp

jlb02D    mov       savFCB,r11
          movb      stat$4,1(r11)       reject with status 4 (not permitted)
          rtwp

jlb02E    li        r2,sealgn           disk I/O must be on sector boundary
          b         abort               report error and abort

. handle fd = 0 = console
.
rwcons    movb      *r11,r0             fetch FCB command
          srl       r0,8
          ci        r0,read$            is it a read$ coomand?
          jeq       jlb037              yes ->

. console write
.
          mov       6(r11),r6           get length
          mov       4(r11),r7           get buffer
          clr       r2
          li        r5,outbuf           terminal buffer
          li        r4,80               max length
jlb03B    mov       r6,r6               len zero?
          jeq       jlb038              yes -> done
          dec       r6
          movb      *r7+,r2
jlb03E    dec       r4                  still space?
          jlt       jlb039              no -> move to next line
          movb      r2,*r5+             move char to buffer
          srl       r2,8
          ci        r2,0D               was it CR?
          jeq       jlb03A              yes -> check output break
          bl        echoraw             send char to console driver
          jmp       jlb03B

jlb03A    bl        echcook             print ctl char
          li        r4,80               resume on new line
          li        r5,outbuf
          mov       cstogg,r2           output halted?
          jeq       jlb03C              yes ->
jlb03D    bl        termrd              read char
          ci        r2,013              was it ^S ?
          jne       jlb03D              no -> keep waiting
          clr       cstogg              clear flag
jlb03C    seto      r2                  ??
          jmp       jlb03B              resume output

jlb039    li        r4,80               resume on new line
          li        r5,outbuf
          jmp       jlb03E

jlb038    inc       r2                  copy to printer
          jne       jlb03F
          li        r5,outbuf

jlb03F    li        r0,07F00            add eoo marker to outbuffer
          movb      r0,*r5
          mov       cetogg,r0
          jne       rwprnt

jlb04B    mov       savFCB,r11          restore FCB ptr
          mov       6(r11),8(r11)       transferred len = requested len
jlb043    movb      zerob,1(r11)        return status = ok
          rtwp

. console read
.
jlb037    mov       6(r11),r0           get remaining len
          jeq       jlb040              zero ? -> done
          mov       is$raw,r0           raw input?
          jeq       jlb041              no -> do cooked

jlb042    bl        TRSTAT              wait for char available
          jeq       jlb042
          bl        TREADC              read char from device
          mov       savFCB,r11          restore FCB ptr
          mov       4(r11),r1           get buffer addr
          swpb      r2
          movb      r2,*r1              store char
          mov       one,8(r11)          transferred length = 1
          jmp       jlb043              return status = ok

jlb040    bl        TRSTAT              check char available
          jeq       jlb044              no -> report eof
          mov       savFCB,r11          restore FCB ptr
          clr       8(r11)              transferred length = 0
          jmp       jlb043              return status = ok
jlb044    mov       savFCB,r11          transferred length = 0
          jmp       jlb035              return staus = 1 = eof

jlb041    li        r0,lbl081           set up fake return to lbl081
          mov       r0,*r10+
          b         rdlloop             "call" line input routine

lbl081    mov       savFCB,r11          restore FCB ptr
          mov       4(r11),r1           get buffer addr
          clr       r0                  clear overflow flag
          c         r6,6(r11)           is length within buffer?
          jl        jlb045              yes ->
          seto      r0                  set overflow flag
          mov       6(r11),r6           trunc len to buffer size
jlb045    mov       r6,8(r11)           store in bytes transferred
jlb047    dec       r6                  copy line to buffer
          jlt       jlb046
          movb      *r7+,*r1+
          jmp       jlb047

jlb046    li        r2,00D00            CR in upper byte
          inc       r0                  space in buffer?
          jeq       jlb048              no ->
          movb      r2,*r1              add CR to line
          inc       8(r11)              adjust transferred count
jlb048    li        r0,07F00            add eoo marker
          mov       r0,outbuf
          jmp       jlb043              return status = ok

. handle fd = 255 = params
.
rwpara    movb      *r11,r0             get operation from FCB
          srl       r0,8
          ci        r0,read$            is it a read$ command?
          jeq       jlb049
          b         jlb02D              no -> error 4 (not permitted)
jlb049    mov       prmptr,r7           input is param string
          mov       prmlen,r6           with param len
          jmp       lbl081

. handle fd = 254 = printer
.
rwprnt    mov       savFCB,r11          get operation from FCB
          movb      *r11,r0
          srl       r0,8
          ci        r0,write$           is it a write$ command ?
          jne       jlb04A              no -> error 4 (not permitted)
          mov       4(r11),r5           buffer ptr
          mov       6(r11),r6           buffer len
          li        r1,w$               w$
          li        r8,UT$PR1           printer dev data
          bl        PIOPRT              call driver
          jmp       jlb04B              return OK
.
. SEEK
.
seek      movb      3(r11),r0           get fd from FCB
          srl       r0,8
          bl        is$dev              is a device file
          data      lbl083              -> yes, ignore & report ok
          mov       savFCB,r11          restore FCB ptr
          ci        r0,0A               fd > 10?
          jh        jlb04A              report error 4 (not permitted)
          dec       r0                  find file table entry
          mpy       ftesiz,r0
          mov       ft$sec(r1),r2       not open?
          jeq       jlb04A              yes -> report error 4
          mov       4(r11),r3           get requested offset in bytes
          mov       6(r11),r4
          coc       byt07F,r4           alligned?
          jeq       jlb04C              no -> report disk I/O error
          srl       r4,7                convert to sectors
          src       r3,7
          andi      r3,0FE00
          soc       r3,r4               r4 is offset in sectors
          movb      2(r11),r0           get whence
          srl       r0,8
          jeq       jlb04D              0? -> seek start
          dec       r0
          jeq       jlb04E              1? -> seek cur
          dec       r0
          jne       jlb04F              not 2? -> error
          a         ft$len(r1),r4       add end
jlb04D    mov       r4,ft$ofs(r1)       do seek

          mov       r4,r0               report new offset in bytes
          sla       r4,7
          mov       r4,10(r11)
          srl       r0,9
          mov       r0,8(r11)
lbl083    movb      zerob,1(r11)        return status = ok
          rtwp

jlb04E    a         ft$ofs(r1),r4       calc seek cur
          jmp       jlb04D              -> do seek

jlb04F    movb      stat$6,1(r11)       report status = 6 (bad offset)
          rtwp

jlb04A    b         jlb02D              far jump to error 4 (not permitted)
jlb04C    b         jlb02E              far jump to disk I/O error, abort
.
. TRAP
.
trap      mov       2(r11),r0           check trap selection bits
          jeq       jlb050              none set -> clear trap
          mov       r11,trapFCB         save ptr to trap JSYS block
          clr       6(r11)              clear previous addr
          clr       8(r11)              clear previous mask
          bl        INTCHK              check for ^C
          rtwp

jlb050    clr       trapFCB             clear trap ptr
          rtwp
.
. MEM
.
mem       mov       2(r11),r0           get sub-command
          ci        r0,1                is it 1?
          jne       jlb051              no -> not supported
          mov       pgmld,r0            pgm end = bottom free mem
          a         pgmlen,r0
          mov       r0,4(r11)
          s         00030,r0            length is bottom to MDEX start      
          neg       r0
          mov       r0,6(r11)
          movb      zerob,1(r11)        return status = ok
          rtwp

jlb051    movb      stat$6,1(r11)       return status 6
          rtwp
.
. IOCTL
.
ioctl     cb        3(r11),zero
          jne       jlb052
          cb        2(r11),oneb
          jle       jlb052
          mov       4(r11),r1
          movb      1(r1),is$raw+1      set/clear raw mode
jlb052    movb      zerob,1(r11)        return status = ok
          rtwp
.
. EXEC
.
exec      mov       2(r11),r6           get path string from FCB
          srl       r6,8
          mov       4(r11),r7
          b         lbl086              and treat as a command line
.
. TIME
.
time      movb      oneb,1(r11)         reject with status = 1
          rtwp

do$brk    mov       in$pgm,r0           user program running?
          jne       jlb053              yes -> test for trap handler
          b         cmdscn              else, restart main command loop

jlb053    mov       trapFCB,r1          trap handler set?
          jne       jlb054              yes -> make trap call
jlb055    li        r2,seterm           abort with "Terminated by ^C"        
          b         abort               and resume main command loop

jlb054    mov       2(r1),r0            check trap selection bits
          andi      r0,1                ^C mask set?
          jeq       jlb055              no -> abort
          mov       r14,6(r1)           report caller address
          clr       8(r1)               clear error code for console trap
          mov       savFCB,10(r1)       report FCB ptr of JSYS
          mov       4(r1),r14           return to trap address
          rtwp
.
. Report irrecoverable error, abort program and resume command loop
. Ptr to error message is in r2
.
abort     clr       in$pgm              no longer in program
          li        r0,edtpkt           edit packet
          bl        EDIT$
          mov       r2,r0               format message
          bl        EMSG$

lbl065    li        r0,serrat           format " at "
          bl        EMSG$
          mov       r14,r0
          li        r1,4
          bl        EHEXF$              format hex address
          bl        lbl089              print line
          li        r0,edtpkt           new line
          bl        EDIT$
          li        r0,serrR0           format "R0-R7:"
          bl        EMSG$
          mov       r13,r4              register pointer
          bl        lbl08B              format register contents
          li        r0,edtpkt           new line
          bl        EDIT$
          li        r0,serrR8           format "R8-R15:"
          bl        EMSG$
          mov       r13,r4
          ai        r4,16               register pointer
          bl        lbl08B              format register contents
          b         jlb019              resume command loop

lbl08B    mov       r11,*r10+           format 8 registers as hex
          li        r3,8
jlb056    li        r0,2
          bl        ESKIP$
          mov       *r4+,r0
          li        r1,4
          bl        EHEXF$
          dec       r3
          jne       jlb056
          bl        lbl089              print result & close
          dect      r10
          mov       *r10,r11
          rt

lbl089    mov       r11,*r10+           print edit result & close
          bl        ECOLN$
          mov       r0,r2
          bl        EDITX$              close packet
          mov       r2,r0
          li        r1,outbuf
          bl        prtstr              print packet
          dect      r10
          mov       *r10,r11
          rt
.
. Read an execuatble path: ["1/" | "2/"] filename. A filename has
. digits, letters and $ as permitted characters. The filename has
. max 12 characters.
.
getpath   mov       r11,*r10+           parse input line for command
          seto      dsknum              undefine disk number
jlb05E    mov       spaces,r0           clear file name
          li        r1,filnam
          li        r2,6
jlb057    mov       r0,*r1+
          dec       r2
          jne       jlb057

jlb059    bl        getchr              next char
          jlt       jlb058              eol? ->
          ci        r0,' '              skip spaces
          jeq       jlb059

          li        r1,filnam           copy only first 12 chars to file name
          li        r2,12
jlb05C    dec       r2
          jlt       jlb05A
          swpb      r0
          movb      r0,*r1+
jlb05A    bl        getchr              get next char
          jlt       jlb05B              end on eol, comma, space and (
          ci        r0,','
          jeq       jlb05B
          ci        r0,'('
          jeq       jlb05B
          ci        r0,' '
          jeq       jlb05B
          ci        r0,'/'
          jne       jlb05C              before a slash we must have a dsknum
          movb      filnam,r0
          srl       r0,8
          ai        r0,0FFCF            ch := ch - '0' - 1
          jlt       jlb05D              < 0 ? -> bad dsknum
          ci        r0,2                > 1 ? -> bad dsknum
          jhe       jlb05D
          mov       r0,dsknum           save dsknum
          jmp       jlb05E              restart filename fill

jlb05D    dect      r10                 2nd error path: bad dsknum
          mov       *r10,r11
          mov       2(r11),r11
          rt

jlb058    dect      r10                 1st error: empty line
          mov       *r10,r11
          mov       *r11,r11
          rt

jlb05B    dect      r10                 normal return
          mov       *r10,r11
          inc       r6                  push back look ahead
          dec       r7
          b         4(r11)
.
. Get the disk number. Unspecified is converted to 1/
.
getdsk    mov       dsknum,r0           fetch dsknum, undef = 0
          jlt       jlb05F
          rt
jlb05F    clr       dsknum
          rt

ckspcl    li        r0,5                check for special files
          li        r1,lbl08E           special name table
jlb062    li        r2,filnam
          mov       r1,r3
          li        r4,6
jlb061    c         *r2+,*r3+
          jne       jlb060
          dec       r4
          jne       jlb061
          mov       *r3+,r2             found, handle to r2
jlb063    mov       *r11,r11            found return
          rt

jlb060    ai        r1,0E               next entry
          dec       r0                  past last?
          jne       jlb062              -> no
jlb065    b         2(r11)              not found return

.
. Check if a fd is for a special device and return
. via separare found/not found paths
.
is$dev    li        r1,lbl08F           look up special fd
          li        r2,5
jlb064    c         r0,*r1
          jeq       jlb063              -> found
          ai        r1,14
          dec       r2
          jne       jlb064
          jmp       jlb065              -> not found

lbl08E    text      "CONS.DEV    "
lbl08F    data      00000
          text      "PARAM.DEV   "
          data      000ff
          text      "PRINT.DEV   "
          data      000fe
          text      "DISC$1.DEV  "
          data      000f0
          text      "DISC$2.DEV  "
          data      000f1

.
. Read decimal or hexadecimal number
.
getnum    mov       r11,*r10+           unused in MDEX ???
          clr       r1
          clr       r3

jlb067    bl        getchr              get number
          jlt       jlb066              eol? -> done
          ci        r0,' '              skip spaces
          jeq       jlb067
          ci        r0,'0'              leading zero?
          jeq       hexnum              -> do hex

decnum    ci        r0,'0'              get decimal number
          jlt       jlb066
          ci        r0,'9'
          jgt       jlb066
          andi      r0,0F
          mpy       c10,r1              num := num * 10
          mov       r2,r1
          a         r0,r1
          inc       r3
          bl        getchr
          jlt       jlb066
          jmp       decnum

jlb066    inc       r6                  push back look ahead
          dec       r7
          dect      r10                 return
          mov       *r10,r11
          rt

hexnum    ci        r0,'0'              get hexadecimal number
          jlt       jlb066
          ci        r0,'9'
          jgt       jlb06A
          andi      r0,0F
jlb06B    sla       r1,4                num := num * 16
          a         r0,r1
          inc       r3
          bl        getchr
          jlt       jlb066
          jmp       hexnum

jlb06A    ci        r0,'A'
          jlt       jlb066
          ci        r0,'F'
          jgt       jlb066
          ai        r0,0FFC9            ch := ch - 'A' + 10
          jmp       jlb06B

gethex    mov       r11,*r10+           skip spaces and get hex number
          clr       r1
          clr       r3
jlb06C    bl        getchr
          jlt       jlb066              eol? -> done
          ci        r0,' '              skip space
          jeq       jlb06C
          jmp       hexnum              get hex

getchr    dec       r6                  chars left in buffer?
          jlt       jlb06D              no -> done
          movb      *r7+,r0             get char
          srl       r0,8
          ci        r0,060              make uppercase
          jlt       jlb06E
          andi      r0,05F
jlb06D    rt

jlb06E    andi      r0,07F
          rt

.
. Lookup a file name in the disk directory
.
srchdir   mov       r11,*r10+           search file in directory
          mov       00036,curtrk        get dir track
          mov       00038,cursec        get dir sec
          bl        rd$sec              read sector
          mov       secbuf,r0           starts with '. '?
          ci        r0,'. '
          jne       jlb06F              no ->
          jmp       jlb070

jlb075    bl        rd$sec              read new sector
jlb070    li        r0,7                7 dir entries per sector
          li        r1,secbuf

jlb074    mov       r1,r2               check dir entry
          li        r3,filnam
          li        r4,6                12 chars in filename
jlb072    c         *r2+,*r3+
          jne       jlb071              -> name not found
          dec       r4
          jne       jlb072
          jmp       jlb073              -> name found

jlb071    c         *r1,marker          dir entry has 0FFFF marker?
          jeq       jlb06F              yes -> name not found
          ai        r1,18               move to next dir entry
          dec       r0                  beyond last?
          jne       jlb074              no -> check next
          bl        nxttrk              next track number
          jmp       jlb075

jlb06F    dect      r10                 take error return
          mov       *r10,r11
          mov       *r11,r11
          rt

jlb073    mov       12(r1),r3           get block number of start
          clr       r2
          div       c26,r2              divide by sectors/track
          inc       r3                  set sec, save prev sec in r3
          mov       r3,r11
          mov       cursec,r3
          mov       r11,cursec          set track, save prev track in r2 
          mov       r2,r11
          mov       curtrk,r2
          mov       r11,curtrk
          dect      r10                 take normal return
          mov       *r10,r11
          b         2(r11)
.
. Work with disk device driver to read a sector
.
rd$sec    mov       r11,*r10+           read track/sector
          li        r1,r$
jlb077    mov       curtrk,r2           get track
          mov       cursec,r4           get sector
          li        r5,secbuf           sector buf
          li        r6,128              sector len
          bl        lbl045              disk info ptr to r8
          bl        PIOPSF              call disk driver
          mov       r1,r1               test status
          jeq       jlb076              -> ok
lbl046    li        r0,0000F
          li        r1,sioerr           report disk I/O error
          bl        prtstr              print string
          b         cmdscn              and resume command loop

jlb076    dect      r10                 return
          mov       *r10,r11
          rt
.
. Work with disk device driver to write a sector
.
wr$sec    mov       r11,*r10+           write track/sector
          li        r1,2
          jmp       jlb077

lbl045    mov       dsknum,r8
          a         r8,r8
          mov       dsktbl(r8),r8
          rt
.
. Move current position to next sector / track
.
nxttrk    mov       cursec,r0           next sector
          ci        r0,26               past 26?
          jl        jlb078              no, just incr. sector
          clr       cursec              else wrap to next track
          inc       curtrk
jlb078    inc       cursec
          rt

zero      bss       2
zerob     equ       zero+1
one       data      1
oneb      equ       one+1
c10       data      10                  constant 10 for decimal conversion
ftesiz    data      10                  size of file table entry (5 words)
byt07F    data      07F
c26       data      01A                 26 sectors / track on a 8 inch floppy
spaces    data      '  '
marker    data      0FFFF               binary executable magic
pmagic    data      00084               pascal executable magic
pasobj    text      "PASC$.OBJ   "
sh$nam    text      "SHELL$.OBJ  "
stat$2    byte      2                   error codes
stat$3    byte      3
stat$4    byte      4
stat$5    byte      5
stat$6    byte      6
stat$7    byte      7
stat$8    byte      8
          byte      0

dsktbl    data      UT$FD1
          data      UT$FD2

pgmhdr    bss       6                   program header
pgmld     bss       2                   program load address
pgmlen    bss       2                   program length in bytes
pgm$wp    bss       2                   initial WP
pgm$pc    bss       2                   initial PC

filnam    bss       12                  filename
dsknum    bss       2
curtrk    bss       2
cursec    bss       2

params    bss       80                  parameter string
prmlen    bss       2                   param string remaing length
prmptr    bss       2                   ptr into params
savlen    bss       2                   tmp storage for r6 length
savbuf    bss       2                   tmp storage for r7 buf ptr

stack     bss       20                  r10 return stack

secbuf    bss       128                 secbuf = 128 bytes

maxfd     bss       2                   highest fd in use
.
. file table: 10 entries of 10 bytes each
.
ft$trk    bss       2                   first track
ft$sec    bss       2                   first sector (0 if slot not used)
ft$len    bss       2                   file len (in sectors)
ft$ofs    bss       2                   file offset (in sectors)
ft$dsk    bss       2                   file disk (0 or 1)
          bss       90                  and 9 more slots

savFCB    bss       2                   saved FCB ptr
in$pgm    bss       2                   user program is running
trapFCB   bss       2                   ptr to trap FCB of user program
is$raw    bss       2                   console in raw mode

wp1       bss       32
wp2       bss       32
userws    bss       32

edtpkt    bss       14                  edit packet
          data      '& '
          bss       2
          data      outbuf
          data      80
          bss       10
.
.
. ********************************************************************
. *                     MESSAGE FORMATTING PACKAGE                   *
. ********************************************************************
.
EDIT$*    mov       r0,*r0+             build blwp vector with "packet"
          mov       inivec,*r0          and jump to lbl001
          dect      r0
          blwp      *r0

inivec    data      init

init      mov       24(r13),r12         save old R12 and place packet ptr there
          mov       r0,24(r13)
          li        r1,next             R0,R1 is blwp vector to next
          mov       r9,r8               ptr to start of buffer
          mov       r10,r5              set end ptr
          a         r9,r5
          mov       r10,r2              clear buffer with spaces
          li        r3,'  '
l1        dec       r2
          jlt       l0      
          movb      r3,*r8+
          jmp       l1      
l0        mov       r9,r8               ptr to start of buffer

return    mov       22(r13),r14         return to caller via old R11
          rtwp     
 
EDITX$*   blwp      *r12                enter WS
          mov       r12,24(r13)         restore old R12
          mov       r0,0(r13)           set old R0 to packet
          jmp       return  

EDITR$*   blwp      *r0                 enter WS
          mov       24(r13),r12         save old R12
          mov       r0,24(r13)          set old R12 to packet ptr
          jmp       return  

next      b         *r14                jump to instruction after blwp

ECHAR$*   blwp      *r12                enter WS
          movb      1(r13),r2           get char
          bl        putch 
          jmp       return  

ESKIP$*   a         r0,16(r12)          just move ptr
          rt    
    
ECOL$*    mov       18(r12),16(r12)     set ptr to start of buffer
          a         r0,16(r12)          and add index
          rt       
 
ECOLN$*   mov       16(r12),r0          get ptr
          s         18(r12),r0          subtract start of buffer -> index
          rt        

ECOPY$*   blwp      *r12                enter WS
          mov       0(r13),r3           get addr
          mov       2(r13),r4           get len
l3        dec       r4                  copy string into buffer
          jlt       return  
          movb      *r3+,r2
          bl        putch 
          jmp       l3      

EMSG$*    blwp      *r12                enter WS
          mov       0(r13),r6           get addr
l4        movb      *r6+,r2             get ch
          cb        r2,r7               is stop char?
          jeq       return              yes -> done
          bl        putch 
          jmp       l4      

EMSGR$*   blwp      *r12                enter WS
          jmp       l4                  resume copy

EMSG1$*   blwp      *r12                as emsg$, but use tmp ptr
          mov       0(r13),r3
l5        movb      *r3+,r2
          cb        r7,r2
          jeq       return  
          bl        putch 
          jmp       l5      

EHEXF$*   blwp      *r12                enter WS
          mov       0(r13),r3           get value
          mov       2(r13),r4           get len

dohex    mov       r4,r0                go to last position
          a         r4,r8
          dec       r8                  back up to last digit position
l7        dec       r4                  all digits done?
          jlt       l6                  -> yes
          mov       r3,r2               get hex digit
          andi      r2,0F
          movb      HEXTAB(r2),r2
          bl        putch               and put in string
          dect      r8                  backup to next higher digit pos
          srl       r3,4                next digit in value
          jmp       l7    

l6        inc       r8                  set r8 past number
          a         r0,r8
          stwp      r0                  restore R0
          jmp       return  

EHEXV$*   blwp      *r12                enter WS
          mov       0(r13),r3           get value
          li        r4,1                len = 1
          ci        r3,10               value is 0..9?
          jl        dohex               print as single hex digit
          mov       r3,r2
l8        inc       r4                  increase length
          ci        r2,16               more than 1 digit remaining?
          jl        dohex               drop last digit & try again
          srl       r2,4                
          jmp       l8      

HEXTAB*   text      '0123456789ABCDEF'
          even

EDECF$*   blwp      *r12               enter WS
          bl        decsz              calc len in r4
          mov       2(r13),r3          get user len
          c         r3,r4              trunc to user len as needed
          jl        dodec  
          mov       r3,r4
          jmp       dodec  

EDECV$*   blwp      *r12               enter WS
          bl        decsz              calc len

dodec     a         r4,r8              set ptr past last digit                
          mov       r8,r3              save
          dec       r8                 backup to last digit

          mov       r1,r2              make value 32 bit
l9        clr       r1
          div       logtab,r1          divide by 10        
          ai        r2,'0'             digit is remainder
          swpb      r2
          bl        putch 
          dect      r8                 backup to next higher digit pos
          mov       r1,r2              make rest value 32 bits again
          jne       l9                 more digits? -> loop

          mov       0(r13),r2          refetch value
          jlt       l10                < 0? -> yes, add '-' to front
l11       mov       r3,r8              set ptr past last digit again
          li        r1,next            restore r1
          b         return

l10       li        r2,'- '            output '-'
          bl        putch 
          jmp       l11     

decsz     clr       r4                 len = 0
          mov       0(r13),r1          get value
          jlt       mkeabs             < 0 ? -> yes
l13       li        r2,logtab          find number of digits
l12       inc       r4
          c         r1,*r2+
          jhe       l12     
          rt  
      
mkeabs    inc       r4                 add space for '-'
          abs       r1
          jmp       l13

logtab    data      10
          data      100
          data      1000
          data      10000
          data      0FFFF

putch     c         r8,r5              check ptr in buffer
          jl        l14                yes -> place char
          inc       r8                 else just update ptr
          rt
l14       movb      r2,*r8+
          rt        
.
.
. ********************************************************************
. *                     FLOATING POINT PACKAGE                       *
. ********************************************************************
.
fltxop    
          mov       *r11+,r1            opcode
          mov       *r11+,r2            source address
          mov       *r11,r3             destination address
          a         r1,r1               make word based
          jeq       noopcd              no opcode
          ci        r1,0000C            opcode out of range
          jhe       noopcd              yes, get out
          mov       noopcd(r1),r1       get address of routine
          b         *r1                 go there
noopcd    rtwp                          go back

          data      fltadd              ae$ (01) floating add
          data      fltsub              se$ (02) floating subtract
          data      fltmul              me$ (03) floating multiply
          data      fltdiv              de$ (04) floating divide
          data      fltcmp              ce$ (05) floating compare
.
.         Floating subtract
.
fltsub    mov       *r2,r4              get src top word
          xor       sgnbit,r4           flip sign bit
          jmp       jlb08C              do add
.
.         Floating add
.
fltadd    mov       *r2,r4
jlb08C    mov       *r3,r5

          clr       r7                  get mantissas in r6,r7 and r8,r9
          clr       r9                  top aligned, ie. r7l and r9l are 0
          movb      3(r2),r7
          movb      3(r3),r9
          mov       2(r2),r6
          mov       2(r3),r8
          swpb      r6
          swpb      r8
          movb      1(r2),r6
          movb      1(r3),r8

          mov       r4,r0               compare exponents in r0 and r10
          andi      r0,07F00
          mov       r5,r10
          andi      r10,07F00
          s         r0,r10
          jeq       jlb08D              equal -> mantiassas already aligned
          jlt       jlb08E              src largest?
          ci        r10,00800           difference > 8 digits?
          jhe       jlb08F              dst is result
          mov       r6,r0               shift src mantissa to align with dst
          mov       r7,r1
          bl        lbl0A0              do shift
          mov       r0,r6
          mov       r1,r7
jlb08D    mov       r5,r10              result has dst exponent
          jmp       jlb090

jlb08E    neg       r10                 negate difference
          ci        r10,00800           difference > 8 digits?
          jhe       jlb091              src is result
          mov       r8,r0               shift dst mantissa to align with src
          mov       r9,r1
          bl        lbl0A0
          mov       r0,r8
          mov       r1,r9
          mov       r4,r10              result has src exponent

jlb090    xor       r5,r4               signs different?
          andi      r10,07F00           r10 is exponent result
          coc       sgnbit,r4           signs different?
          jeq       jlb092              yes ->

          a         r7,r9               add mantissas into dst       
          joc       jlb093
          a         r6,r8
          jnc       jlb094

jlb09B    srl       r9,4                add in carry: shoft right one digit         
          mov       r8,r0               and make top digit 1
          srl       r8,4                
          ori       r8,01000
jlb095    src       r0,4
          andi      r0,0F000
          soc       r0,r9
          ai        r10,00100           increase exponent to compensate shift
          jlt       flovfl              overflow? -> return maxreal

jlb094    coc       rndbit,r9           round up?
          jne       jlb097              no ->

          ai        r9,00100            round up
          jnc       jlb097
          inc       r8
          jnc       jlb097
          srl       r9,4                add in carry: shift right one digit
          mov       r8,r0
          srl       r8,4
          src       r0,4
          andi      r0,0F000
          soc       r0,r9
          ai        r8,01000
jlb098    ai        r10,00100           increase exponent to compensate shift
          jlt       flovfl              overflow? -> return maxreal

jlb097    andi      r5,08000            merge sign back into exponent
          soc       r5,r10
          mov       r3,r5
          movb      r10,*r3+            store exponent in dst
          movb      r8,*r3+             store mantisaa in dst
          swpb      r8
          movb      r8,*r3+
          movb      r9,*r3
          mov       *r5,r0              top byte dst to r0
          jmp       jlb099

jlb093    a         r6,r8               handle add carry
          joc       jlb09A
          inc       r8
          joc       jlb09B              -> carry out
          jmp       jlb094              -> no carry out
jlb09A    inc       r8
          jmp       jlb09B              -> carry out

jlb092    s         r7,r9               subtract src from dst
          jnc       jlb09C
          s         r6,r8
          joc       jlb09D              positive? done -> check zero

jlb0A3    inv       r8                  make mantissa positive
          inv       r9
          inc       r9
          jnc       jlb09E
          inc       r8
jlb09E    xor       sgnbit,r5           and flip sign to compensate

jlb09D    mov       r9,r9               low mantissa zero?
          jne       jlb09F              -> no
          c         r8,r9               high mantissa zero?
          jeq       flzero              -> result is zero

jlb09F    czc       topdgt,r8           top digit zero?
          jne       jlb094
          ai        r10,0FF00           reduce exponent, underflow?
          jlt       flunfl              -> result is zero + underflow
          mov       r9,r0               shift mantissa left one digit
          sla       r8,4
          sla       r9,4
          srl       r0,12
          soc       r0,r8
          jmp       jlb09F              repeat test

jlb09C    s         r6,r8               handle sub carry ('borrow')
          jnc       jlb0A2
          dec       r8
          jnc       jlb0A3              -> borrow out
          jmp       jlb09D              -> no borrow out
jlb0A2    dec       r8
          jmp       jlb0A3              -> borrow out

flunfl    andi      r15,001FF           dst zero due to underflow
          ori       r15,02800
          jmp       jlb0A4
flzero    andi      r15,001FF           dst zero, in range
          ori       r15,02000
jlb0A4    clr       *r3+
          clr       *r3
          rtwp

jlb08F    mov       *r3,r0              dst is result: test dst flags
jlb099    stst      r0                  merge result status bits into caller ST
          andi      r0,0E400
          andi      r15,003FF
          soc       r0,r15
          rtwp

jlb091    mov       2(r2),2(r3)         src is result: move & test flags
          mov       r4,*r3
          jmp       jlb099              set caller status bits

flovfl    seto      2(r3)               overflow: set +/- MAXREAL
          li        r0,07FFF
          soc       r5,r0
          mov       r0,*r3
          andi      r15,001FF           set flags + overflow
          ori       r15,08800
          mov       r0,r0
          jlt       jlb0A5
          ori       r15,04000
jlb0A5    rtwp
.
.         Floating multiply
.
fltmul    mov       *r2,r4              get src
          jeq       flzero              zero? -> result zero
          mov       *r3,r5              get dst
          jeq       flzero              zero? -> result zero

          mov       r4,r6
          mov       r4,r10
          mov       r5,r9
          xor       r5,r10
          andi      r4,07F00            isolate exponents
          andi      r5,07F00
          a         r5,r4               add exponents
          jlt       jlb0A6              -> handle averflow
          ai        r4,0C000            subtract double excess 64
          jlt       flunfl              < 0? -> underflow

jlb0AE    mov       *r3,r9              load mantissas
          mov       2(r3),r8
          movb      r8,r9
          swpb      r8
          swpb      r9
          andi      r8,0FF00
          mov       2(r2),r0
          movb      r0,r6
          swpb      r6
          swpb      r0
          andi      r0,0FF00

          mov       r6,r5               multiply mantissas
          mpy       r9,r6
          mpy       r9,r0
          mpy       r5,r8
          a         r8,r7               add partial products together
          jnc       jlb0A7
          inc       r6
jlb0A7    a         r0,r7
          jnc       jlb0A8
          inc       r6

jlb0A8    czc       topdgt,r6           top digit set?
          jne       jlb0A9
          ai        r7,8                round up unaligned mantissa
          jnc       jlb0AA
          inc       r6
          czc       topdgt,r6           top digit set after rounding?
          jne       jlb0AB

jlb0AA    ai        r4,0FF00            normalize: reduce exponent
          jlt       flunfl              <0 ? -> underflow
          srl       r7,4                shift mantissa left one digit
          mov       r6,r0
          srl       r6,4
          src       r0,4
          andi      r0,0F000
          soc       r0,r7

jlb0AD    andi      r10,08000           isolate sign
          soc       r4,r10              merge in exponent
          soc       r10,r6              merge into mantissa
          mov       r7,2(r3)            store in dst
          mov       r6,*r3
          jmp       jlb099              set flags & return

jlb0A9    ai        r7,00080            round up aligned mantissa
          jnc       jlb0AC
          inc       r6                  cannot have carry out
jlb0AC    swpb      r7                  prepare for merge with exp & sign
          swpb      r6
          movb      r6,r7
          andi      r6,000FF
          jmp       jlb0AD

jlb0AB    clr       r7                  set minimum mantissa ?
          li        r6,00010
          jmp       jlb0AD

jlb0A6    ai        r4,0C000            subtract out double excess 64
          jlt       flovfl              if still < 0 -> overflow
          jmp       jlb0AE              continue
.
.         Floating divide
.
fltdiv    mov       *r2,r4              get src (divisor)
          jeq       flovfl              div by zero? -> overflow
          mov       *r3,r5              get dst (dividend)
          jeq       flzero              zero -> result zero
          mov       r5,r10
          xor       r4,r10              sign bit in r10
          mov       r4,r6
          andi      r4,07F00            r4 is src exp
          andi      r6,000FF
          andi      r5,07F00            r5 is dst exp
          s         r4,r5               subtract exponents
          jlt       jlb0AF              handle overflow
          ai        r5,04000            add back excess 64
          jlt       flovfl              if <0: underflow (not overflow)

jlb0BC    mov       *r3,r8              get mantissas in r6,r7 and r8,r9
          andi      r8,000FF
          mov       2(r2),r7
          mov       2(r3),r9

          sla       r6,6                scale r6,r7 by six bits
          mov       r7,r0
          sla       r7,6
          srl       r0,10
          soc       r0,r6

          div       r6,r8               divide r8,r9 by r6
          mov       r8,r0               "digit" to r0
          mov       r9,r8               "remainder" to r8,r9
          clr       r9
          jeq       jlb0B0              zero? ->
          srl       r8,1                scale r8,r9 by one bit
          jnc       jlb0B1
          li        r9,08000

jlb0B1    div       r6,r8               divide remainder by r6
          mov       r8,r9               combine digits
jlb0B0    mov       r0,r8
          srl       r8,1                scale r8,r9 by one bit
          jnc       jlb0B2
          soc       sgnbit,r9

jlb0B2    mov       r7,r0               get lower part of r6,r7
          jeq       jlb0B3              if zero -> we are done

          src       r0,7                work out correction factor
          mov       r0,r1               <algorithm ??>
          andi      r0,001FF
          andi      r1,0FE00
          div       r6,r0               
          mov       r0,r6
          mpy       r0,r0
          srl       r0,9
          s         r0,r7
          mov       r9,r0
          mpy       r7,r0
          mpy       r8,r6
          a         r0,r7
          jnc       jlb0B4
          inc       r6
jlb0B4    srl       r7,9
          mov       r6,r0
          srl       r6,9
          src       r0,9
          andi      r0,0FF80
          soc       r0,r7
          s         r7,r9
          joc       jlb0B5
          dec       r8
jlb0B5    s         r6,r8

jlb0B3    czc       topdiv,r8           normalize: top digit set?
          jne       jlb0B6              yes -> already normalized
          inc       r9                  round up denormalised mantissa
          jnc       jlb0B7
          inc       r8
          czc       topdiv,r8           normalized after rounding?
          jne       jlb0B8              yes -> scale & combine

jlb0B7    srl       r9,1                shift by one bit is enough
          srl       r8,1
          jnc       jlb0B9
          ori       r9,08000

jlb0B9    andi      r10,08000           isolate sign
          soc       r5,r10              merge in exponent
          soc       r10,r8              merge into mantissa
          mov       r9,2(r3)            store result
          mov       r8,*r3
          b         jlb099              set flags and return

jlb0B6    ai        r9,00010            round up
          jnc       jlb0B8
          inc       r8
jlb0B8    srl       r9,5                scale mantissa back
          mov       r8,r0
          srl       r8,5
          src       r0,5
          andi      r0,0F800
          soc       r0,r9
          ai        r5,00100            adjust normalised mantissa up
          jlt       jlb0BA              overflow? -> return maxreal
          jmp       jlb0B9              compose result & ready

jlb0AF    ai        r5,04000            add back excess 64
          jlt       jlb0BB              still underflow -> report
          jmp       jlb0BC              continue with divide

jlb0BA    b         flovfl
jlb0BB    b         flunfl
.
.         Floating compare
.
fltcmp    mov       *r2,r6              get top words
          mov       *r3,r8
          jlt       jlb0BD              dst < 0?
          mov       r6,r6
          jlt       jlb0BE              src < 0?
          c         r6,r8               top words equal?
          jeq       jlb0BF              yes -> test bottom

jlb0C3    stst      r0                  both positive: fetch compare result
jlb0C0    andi      r0,0FC00            store flags in caller ST
jlb0C2    andi      r15,003FF
          soc       r0,r15
          rtwp                          and return

jlb0BF    c         2(r2),2(r3)         compare low words
jlb0C4    stst      r0                  get compare status bits
          mov       r0,r1
          sra       r1,1
          andi      r0,03FFF
          andi      r1,0C000
          soc       r1,r0
          jmp       jlb0C0

jlb0BD    mov       r6,r6               src < 0?      
          jlt       jlb0C1
          li        r0,0C000            set flags for "dst < src"
          jmp       jlb0C2              return

jlb0C1    andi      r6,07FFF            take absolute values
          andi      r8,07FFF
          c         r8,r6               compare high words
          jne       jlb0C3
          c         2(r8),2(r6)         compare low words ?????? should be r2 & r3
          jmp       jlb0C4

jlb0BE    clr       r0                  set flags for "dst > src"
          jmp       jlb0C2
.
. align mantissa
.
lbl0A0    swpb      r10                 shift right r10 digits
          a         r10,r10
          mov       shrtab-2(r10),r10   get shift routine
          b         *r10

shrtab    data      shr1dg
          data      shr2dg
          data      shr3dg
          data      shr4dg
          data      shr5dg
          data      shr6dg
          data      shr7dg
.
shr1dg    srl       r1,4                shift right 1 hex digit
          mov       r0,r10
          srl       r0,4
          src       r10,4
          andi      r10,0F000
          soc       r10,r1
          rt
.
shr2dg    swpb      r0                  shift right 2 hex digits
          swpb      r1
          movb      r0,r1
          andi      r0,000FF
          rt
.
shr3dg    mov       r0,r10              shift right 3 hex digits
          srl       r0,12
          srl       r1,12
          src       r10,12
          andi      r10,0FFF0
          soc       r10,r1
          rt
.
shr4dg    mov       r0,r1               shift right 4 hex digits
          clr       r0
          rt
.
shr5dg    mov       r0,r1               shift right 5 hex digits
          srl       r1,4
          clr       r0
          rt
.
shr6dg    mov       r0,r1               shift right 6 hex digits
          swpb      r1
          andi      r1,000FF
          clr       r0
          rt
.
shr7dg    mov       r0,r1               shift right 7 hex digits
          srl       r1,12
          clr       r0
          rt
.
.
sgnbit    data      08000               sign bit
topdgt    data      0f000               top digit
topdiv    data      01e00               top digit, scaled for division
rndbit    data      00080               test bit for round up
.
.
. ********************************************************************
. *                     BUFFER MANAGEMENT PRIMITIVES                 *
. ********************************************************************
.
.         Insert buffer at queue end
.
.         LI        R8,<buffer>
.         LI        R9,<queue>
.         BLWP      INSERT$
.         <return>
.
INSRT*    limi      0
          mov       2*r8(r13),r8
          mov       2*r9(r13),r9
          mov       *r9,*r8
          mov       *r9,r11
          mov       r8,2(r11)
          mov       r9,2(r8)
          mov       r8,*r9
          rtwp      
.
.         Insert buffer at queue start
.
.         LI        R8,<buffer>
.         LI        R9,<queue>
.         BLWP      PUSH$
.         <return>
.
PUSH*     limi      0
          mov       2*r8(r13),r8
          mov       2*r9(r13),r9
          mov       2(r9),r11
          mov       r11,2(r8)
          mov       r8,*r11
          mov       r9,*r8
          mov       r8,2(r9)
          rtwp      
.
.         Remove next buffer from queue
.
.         LI        R9,<queue>
.         BLWP      REMOVE$
.         <return>  R8=buffer
.
REMOV*    limi      0
          mov       2*r9(r13),r9
          mov       2(r9),r8
          mov       2(r8),r11
          mov       r11,2(r9)
          mov       r9,*r11
          mov       r8,2*r8(r13)
          rtwp      
.
.         Initialise queue links
.         LI        R9,<queue>
.         BLWP      INITQ$
.         <return>
.
INITQ*    limi      0
          mov       18(r13),r9
          mov       r9,*r9
          mov       r9,2(r9)
          rtwp      
.
.         Allocate a buffer: error if none
.
.         LI        R1,<size in bytes>
.         BLWP      BGET$
.         <return>  R1=buffer allocated
.
BGET*     limi      0
          clr       r8
jlb6      mov       2(r13),r12
          ai        r12,9
          andi      r12,0FFFE
          mov       r10,r11
jlb1      mov       4(r11),r11
          c         r11,r10
          jeq       jlb0    
          c         r12,2(r11)
          jh        jlb1    
          mov       2(r11),r9
          s         r12,r9
          ci        r9,9
          jl        jlb2    
          mov       r9,2(r11)
          a         r11,r9
          mov       r11,*r9
jlb4      neg       r12
          mov       r12,2(r9)
          mov       r14,6(r9)
          neg       r12
          a         r9,r12
          clr       *r12
          ai        r9,8
          mov       r9,2(r13)
          mov       r8,r8
          jeq       jlb3    
          inct      r14
jlb3      rtwp      
.
jlb2      mov       r11,r9
          mov       4(r9),r11
          mov       6(r9),r12
          mov       r11,4(r12)
          mov       r12,6(r11)
          mov       2(r9),r12
          jmp       jlb4    
jlb0      mov       r8,r8
          jne       jlb5    
.
          jsys      ex1
ex1       byte      exit$,0
          data      00010
.
jlb5      mov       *r14,r14
          rtwp      
.
.         Allocate a buffer: return if none
.
.         LI        R1,<size in bytes>
.         BLWP      BGETA$
.         DATA      <insufficient space>
.         <return>  R1=buffer allocated
.
BGETA*    limi      0
          seto      r8
          jmp       jlb6    
.
.         Release buffer
.
.         LI        R1,<buffer address>
.         BLWP      BREL$
.         <return>
.
BREL*     limi      0
          mov       2(r13),r12
          ai        r12,0FFF8
          mov       2(r12),r11
          jgt       jlb7    
          mov       *r12,r11
          jne       jlb8    
jlb12     mov       r10,6(r12)
          mov       4(r10),4(r12)
          mov       r12,4(r10)
          mov       4(r12),r9
          mov       r12,6(r9)
          mov       r12,r11
jlb8      s         2(r12),r12
          mov       *r12,r9
          jne       jlb9    
          mov       2(r12),r9
          jlt       jlb10   
          mov       4(r12),r9
          mov       6(r12),r8
          mov       r9,4(r8)
          mov       r8,6(r9)
          a         2(r12),r12
jlb10     mov       r11,*r12
          s         r11,r12
          mov       r12,2(r11)
jlb11     rtwp   

exit$     equ       2
.
jlb7      jsys      ex2
ex2       byte      exit$,0 
          data      00011
.
jlb9      jsys      ex3
ex3       byte      exit$,0 
          data      00012
.
.         Add space to buffer pool
.
.         LI        R0,<length of area to add>
.         LI        R1,<address of area to add>
.         BLWP      BEXP$
.         <return>
.
BEXP*     limi      0
          mov       0(r13),r11
          mov       2(r13),r12
          andi      r11,0FFFE
          ai        r12,1
          andi      r12,0FFFE
          ci        r11,0E
          jl        jlb11   
          clr       *r12
          ai        r11,0FFFC
          mov       r11,2(r12)
          a         r12,r11
          clr       *r11+
          seto      *r11
          neg       2(r12)
          jmp       jlb12   
.
.
. ********************************************************************
. *                     TERMINAL HANDLER                             *
. ********************************************************************
.
.
.         LI        R0,length
.         LI        R1,startoftext
.         BL        prtstr
.
prtstr    pshr      r11                 print message
          mov       cetogg,r11          do we want to send to printer
          jeq       noprnt              -> no
.
          mov       r0,saver0
          mov       r1,saver1
          mov       r5,saver5
          mov       r6,saver6
          mov       r8,saver8
          mov       r0,r6               length
          mov       r1,r5               start
          li        r1,w$
          li        r8,UT$PR1
          bl        PIOPRT
          mov       saver0,r0
          mov       saver1,r1
          mov       saver5,r5
          mov       saver6,r6
          mov       saver8,r8

noprnt    dec       r0                  length-1
          jlt       finish              finished
          movb      *r1+,r2             no, get another char
          srl       r2,8                rigth adjust
          bl        echcook             echo cooked
          jmp       noprnt

finish    li        r2,0D               CR
          bl        echcook             echo cooked
          mov       cstogg,r0           ^S active?
          jne       waitcs              yes go and wait for another
gohome    popj

waitcs    
          bl        termrd
          ci        r2,013              is it ^S
          jne       waitcs              no,
          clr       cstogg              yes, clear it
          jmp       gohome              and get out of here
.
. Read a 'cooked' line from the console terminal
.
rdline    pshr      r11                 main subbroutine entry
          mov       cetogg,cetog2	save print ^E toggle

rdrtype   bl        retype              retype outbuf & enter loop
          clr       cetog2

. 2nd entry into realine: store into input buffer
.
rdlloop   clr       r6                  enter realine loop
          li        r7,inpbuf           set up input buffer
	  
nxtchr    bl        termrd              read char from console terminal
          ci        r2,01B              ESC
          jeq       escrou
          ci        r2,0D               CR = ^M
          jeq       contrm
          ci        r2,018              ^X  delete line
          jeq       contrx
          ci        r2,08               ^H  backspace
          jeq       contrh
          ci        r2,012              ^R  retype line
          jeq       contrr
          ci        r2,017              ^W  delete word
          jeq       contrw

          ci        r6,80               max line length?
          jeq       nxtchr              ignore further content
          bl        echcook             echo char cooked

jlb0DD    swpb      r2                  place in input buffer
          movb      r2,*r7+
          inc       r6
          jmp       nxtchr              and continue

. ESC = next char is raw, echoed raw
escrou    bl        TRSTAT              wait for next char
          jeq       escrou
          bl        TREADC
          ci        r6,050
          jeq       nxtchr
          bl        echoraw             echo char as 'raw'
          jmp       jlb0DD

. ^M = CR = finish line & return
contrm    bl        echcook             echo cooked
          mov       cetogg,r0           copy to printer?
          jeq       jlb0DE              no ->

          swpb      r2                  place in buffer
          movb      r2,*r7
          mov       r6,saver6
          mov       r8,saver8
          mov       r5,saver5
          li        r5,inpbuf           input buffer
          li        r1,w$               set w$
          li        r8,UT$PR1           call printer driver
          inc       r6
          bl        PIOPRT
          mov       saver5,r5
          mov       saver8,r8
          mov       saver6,r6           drop from buffer again

jlb0DE    li        r7,inpbuf           reset r7 to input buffer
          popj                          return

. ^X = delete line
contrx    li        r0,CRTCON           glass terminal ?      
          jne       jlb0DF              -> yes
          bl        echcook             echo cooked
          li        r2,0D               load CR
          bl        echcook             echo cooked
          jmp       rdrtype             resume line input
          
jlb0DF    dec       r6                  everything rubbed?
          jlt       rdlloop             yes -> resume
          dec       r7
          bl        rubout              rub out last char
          jmp       jlb0DF
.
. ^H = backspace
contrh    dec       r6                  at start of line ?
          jlt       rdlloop             -> yes, ignore
          dec       r7
          bl        rubout              rubout one char
          jmp       nxtchr              resume input loop
.
. ^R = retype line
contrr    bl        echcook             echo cooked
          li        r2,0D               load CR
          bl        echcook             echo cooked
          bl        retype              retype line
          li        r1,inpbuf           begin of buffer
jlb0E1    c         r1,r7
          jeq       nxtchr              done -> resume input loop
          movb      *r1+,r2             echo one char
          srl       r2,8
          bl        echcook
          jmp       jlb0E1              until done
.
. ^W = delete word
contrw    dec       r6                  if at start line, resume loop
          jlt       rdlloop
          dec       r7
          bl        rubout              rubout character on screen
          bl        isword              is it a word char (letter, digit, $)?
          jne       contrw              loop until we hit a word

jlb0E3    dec       r6                  at start?
          jlt       rdlloop             yes -> resume loop
          dec       r7                  backup one char
          bl        isword              check its type
          jne       jlb0E2              not a word, done
          bl        rubout              rubout on screen
          jmp       jlb0E3              until all done
jlb0E2    inc       r6                  restore look ahead char
          inc       r7
          b         nxtchr              resume loop
.
. check if character is a word character
isword    movb      *r7,r0              inspect character
          srl       r0,8
          ci        r0,'$'              $ is part of word
          jeq       jlb0E4
          ci        r0,060              make lower case
          jlt       jlb0E5
          andi      r0,05F
jlb0E5    ci        r0,'0'              char < '0' ?
          jlt       jlb0E6              not part of a word
          ci        r0,'9'              char > '9'
          jgt       jlb0E7              check letters
jlb0E4    c         r0,r0               set EQ flag & return
jlb0E6    rt

jlb0E7    ci        r0,'A'              char < 'A' ?
          jlt       jlb0E6              not part of a word
          ci        r0,'Z'              char > 'Z' ?
          jgt       jlb0E6              not part of a word
          jmp       jlb0E4              is ok, return with EQ set.
.
. rubout screen character (two for control)
rubout    pshr      r11
          bl        rubone              rubout
          movb      *r7,r0              get char
          srl       r0,8
          ci        r0,' '              was it a ctrl?
          jlt       jlb0E8              yes ->
jlb0E9    popj

jlb0E8    bl        rubone              rubout ^ as well
          jmp       jlb0E9              done
.
. rubout single character
rubone    pshr      r11
          li        r2,08               backspace
          bl        echoraw             echo raw
          li        r2,' '              space
          bl        echoraw             echo raw
          li        r2,08               backspace
          bl        echoraw             echo raw
          popj
.
. retype output buffer to console / printer
.
retype    pshr      r11
          li        r1,outbuf           go through output buffer
jlb0EB    movb      *r1+,r2
          srl       r2,8
          ci        r2,07F              end of buffer?
          jeq       jlb0EA              yes -> done
          bl        echoraw             echo raw to console
          jmp       jlb0EB              and loop

jlb0EA    mov       cetog2,r0           copy to printer was on?
          jeq       jlb0EC              no ->

          mov       r5,saver5           print prompt as well
          mov       r6,saver6
          mov       r8,saver8
          li        r6,outbuf
jlb0ED    cb        *r6+,eoomrk         find end of output marker
          jne       jlb0ED
          li        r5,outbuf
          s         r5,r6
          dec       r6
          jeq       jlb0EE              -> prompt done
          li        r1,w$
          li        r8,UT$PR1
          bl        PIOPRT
jlb0EE    mov       saver8,r8
          mov       saver6,r6
          mov       saver5,r5

jlb0EC    popj

. echo character in 'cooked mode'
.
echcook   pshr      r11                 save our return
          ci        r2,' '              ch is before space?
          jlt       contrl              yes -> control char
          bl        echoraw
goback    popj                          return

contrl    ci        r2,0D               CR?
          jeq       crchar
          pshr      r2                  save original char
          li        r2,05E              "^"
          bl        echoraw
          popr      r2                  get char back
          ai        r2,64               make capital ascii
          bl        echoraw
          ai        r2,-64              make original char
          jmp       goback
	  
crchar    
          bl        echoraw
          li        r2,TCRDLY           does it need delay
          jeq       nocrdl              no skip delay
crspin    
          pshr      r2                  save r2
          li        r2,07F              dummy char
          bl        echoraw
          popr      r2                  get r2=delay count
          dec       r2                  any more to go
          jne       crspin              yes, once more
nocrdl    
          li        r2,0A               line feed
          bl        echoraw
          li        r2,0D               <cr> give back sent char
          jmp       goback
.
cbreak    li        r2,3                load ^C
          bl        echcook             print on console
          li        r2,0D               load CR
          bl        echcook             print on console
          clr       cstogg              clear output pause (^S)
          mov       intvec,r11          resume at interrupt handler
          rt
.
. print char in r2 to console and test for ^C, ^E and ^S
echoraw    pshr      r11
          mov       is$raw,r11          check for raw mode
          jne       jlb0F4              yes -> do raw (no buffering)

          mov       r2,r3               check for ctl input
          bl        TRSTAT              char available?
          jeq       jlb0F5              no ->
          bl        TREADC              get char from console driver
          ci        r2,02               was it ^C ?   [PNR: changed to ^B]
          jeq       cbreak              yes -> break
          ci        r2,05               was it ^E ?
          jne       jlb0F7              
          inv       cetogg              toggle printer copy
jlb0F7    ci        r2,013              was it ^S ?
          jne       jlb0F5
          seto      cstogg              set output pause (no toggle?)
jlb0F5    mov       r3,r2               restore print char

jlb0F4    bl        TWSTAT              wait for console ready
          jeq       jlb0F4
          bl        TWRITE              write to console
          popj

. read char from console terminal, check for ^C and ^
.
termrd    pshr      r11
jlb0F8    bl        TRSTAT              wait for device ready
          jeq       jlb0F8
jlb0FA    bl        TREADC              read char
          ci        r2,2                is it ^C ?  [PNR: changed to ^B]
          jeq       cbreak              -> break
          ci        r2,5                is it ^E ?
          jne       jlb0F9              no -> done
          inv       cetogg              toggle printer flag
          jmp       jlb0F8              next char
jlb0F9    popj                          return
.
.
INTCHK*   mov       r11,*r10+           check for ^C
          bl        TRSTAT
          jeq       jlb0F9
          jmp       jlb0FA
.
.
eoomrk    data      07f00               end-of-output ("eoo") marker
outbuf    bss       80                  output buffer
inpbuf    bss       82                  input buffer
intvec    bss       2                   break vector (for ^C)
cstogg    bss       2                   pause output (^S)
cetogg    bss       2                   console echo to printer (^E)
cetog2    bss       2                   copy of the above ??
saver0    bss       2                   tmp for r0-r8
saver1    bss       2
saver5    bss       2
saver6    bss       2
saver8    bss       2

          end       mstart
.
