            titl         "MDEX emulator disk driver"
            idt          "IDEDSK"
.
            copy         "../systemdef/sysdef"
.
            dstk         r10         
.
.      EMU DISK CONTROLLER DEVICE HANDLER
.
seclen      equ          128  Logical Sector length (for MDEX)
ctrlra      equ          0fe00
sratew      equ          8    Step rate code for winchester
.
.
. DISC UNIT TABLE
.
       DORG 0
.
.  The following cells occur for all units:
.
master      equ          $
.
dtmstr      bss          2    link to first unit
dtselb      bss          2    select bits for this unit
dtctrk      bss          2    current track position        (nu)
dtprct      bss          2    precession table address
dtmfm       bss          2    non-zero if last was d/density
dt2hd       bss          2    no of heads per disc
dtbtsc      bss          2    no of bytes per sector
dtsctk      bss          2    sectors per track
dttksf      bss          2    tracks per surface
dtsize      bss          2    non-zero for 8" drives        (nu)
dtwini      bss          2    non-zero for winchester/hard disc
dtdeva      bss          2    device address
dtbuff      bss          2    data buffer address
dtbufl      bss          2    buffer length
.
lenslv      equ          $-master
.
.  The following cells exist only for the first unit:
.  this table must match that of the first controller.
.
dtdtrk      bss          2    desired track no
dtdhed      bss          2    desired head no
dtdsec      bss          2    desired sector no
dtmema      bss          2    memory buffer addr
dtmeml      bss          2    memory buffer length
dtcfun      bss          2    current function save
dtrtry      bss          2    retry countdown
dtotrk      bss          2    original desired track
dtodhd      bss          2    original desired head
dtodsc      bss          2    original desired sector
dtoma       bss          2    original memory start addr
dtoml       bss          2    original memory length
dtlsec      bss          2    logical sector no
dtst0       bss          2    status
dttmp1      bss          2
dttmp2      bss          2
dtrbw       bss          2    read before write done flag   (nu)
dtrvrt      bss          2    read verify retry count       (nu)
lenmsr      equ          $-master
.
            rorg
.
.         Controller registers and command codes
.
testcom   equ       09000               test system
restcom   equ       01000               restore head to trk 0, assume 6ms
seekcom   equ       07000               position head to trk
readcom   equ       02000               read sector(s)
writcom   equ       03000               write sector(s)
formcom   equ       05000               format trk
.
.         Modifiers
.
dmamode   equ       0800                dma mode select
rwmult    equ       0400                multiple sector read write
longmode  equ       0200                long mode
.
.         Task file register def
.
rdata     equ       0                   read data
wdata     equ       0                   write data
rerr      equ       1                   error write pre-comp
wpcr      equ       1                   write pre-comp
rscnt     equ       2                   sector count for multiple r/w
wscnt     equ       3
rsecn     equ       3                   sector number
wsecn     equ       3
rcyll     equ       4                   low byte cylinder #
wcyll     equ       4
rcylh     equ       5                   hi byte cylinder #
wcylh     equ       5
rsdh      equ       6                   sector/disc/head numbers
wsdh      equ       6
rstat     equ       7                   status register
wcmd      equ       7                   command register
.
. Size / drive / head register definitions
. Drive select bits
.
winch0      equ          000
winch1      equ          008
winch2      equ          010
.
. Sector size select bits
.
sec128      equ          060
sec256      equ          000
sec512      equ          020
sec1k       equ          040
.
eccbit      equ          080  error correction select for winch
.
. Status bit definitions
.
busyst      equ          08000          command busy
drdyst      equ          04000          drive ready
wrtpst      equ          02000          write protect/fault
skctst      equ          01000          seek complete
drqst       equ          0800           data request
dercst      equ          0400           data error corrected
errst       equ          0100           error
.
.           Start code generation with module marker
.
            data         055aa,055aa
.
UT$FD1*     data         UT$FD1         Link to master
            byte         winch0+sec256,sratew  Unit Select bits,step rate
            data         0              Current track cell
            data         intl16         Precession table address
            data         0              Density factor
            data         2              No of heads/disc
            data         256            Bytes/sector
            data         16             Sectors/track
            data         80             Tracks/surface (640KB, but with hdd CHS)
            data         0              size (NU)
            data         0              0 for floppy
            data         ctrlra         Controller address
            data         savbuf         Sector buffer addresses
            data         0              sector buffer length
            bss          lenmsr-lenslv
            endf

UT$FD2*     data         UT$FD1         Link to master
            byte         winch1+sec256,sratew  
.                                       Unit Select bits, step rate
            data         0              Current track cell
            data         intl16         Precession table address
            data         0              Density factor
            data         2              No of heads/disc
            data         256            Bytes/sector
            data         16             Sectors/track
            data         80             Tracks/surface
            data         0              (NU)
            data         0              0 for floppy
            data         ctrlra         Controller address
            data         savbuf         Sector buffer addresses
            data         0              sector buffer length
.  
DSK$DF*     DATA         4              Density factor multiplier (MDEX)
.
.      Disc sector interlace table
.
intl16      equ          $-1
            byte         1,5,9,13
            byte         2,6,10,14
            byte         3,7,11,15
            byte         4,8,12,16
            even
.
c26         data         26
.
.
. ********************************************************************
. *                       MAIN ROUTINE                               *
. ********************************************************************
.
.      Entry conditions:
.           R1 = function code (read$,write$,init$)
.           R2 = track no.
.           R4 = sector no.
.           R5 = memory start addr
.           R6 = memory length
.           R8 = device table addr
.           R10 = stack pointer
.      Exit conditions:
.           R1 = software status
.                        0 = OK
.                        1 = unrecoverable error
.                        3 = access attempt beyond end of disc
.
PIOPSFD*
       pshr r11
       mov  @dtdeva(r8),r12   fetch device address
       mov  @dtmstr(r8),r9    get master table address
       mov  r1,@dtcfun(r9)    save current function
       ci   r1,init$          IF init function
       jeq  initdrive
       b    @piop1

initdrive
.
.      initialisation of one drive
.
       li   r0,ut$fd1           set user vectors
       mov  r0,@0fc
       li   r0,ut$fd2
       mov  r0,@0fa
.
       b         @success            
.
.      start of main read/write routine
.      convert 8" 26 sectors/track assumption to that actually used
.
piop1
       mov  r2,@dtotrk(r9)    Save original parameters
       mov  r4,@dtodsc(r9)
       mov  r5,@dtoma(r9)
       mov  r6,@dtoml(r9)
.                             Calculate physical addresses:
       mov  @dtbtsc(r8),r0    Physical sector length correction
       srl  r0,7              density factor = dtbtsec/128, (seclen=128)
       mov  r0,@dtmfm(r8)
.
       mov  @dtotrk(r9),r0    Orig track
       mpy  @c26,r0             *26
       a    r4,r1               + orig sector
       dec  r1                  -1 = Abs sector no.
.
.         needs modification if no of logical sectors can be > 2**16
.
       div  @dtmfm(r8),r0     correct for physical sec len
       mov  r1,@dttmp1(r9)    save no of logical sectors offset
.
       mov  r0,r1
       clr  r0                r0/r1=absolute physical sector 0..x
       div  @dtsctk(r8),r0    divide by sectors/track
       inc  r1                r0=track, r1=sector
       mov  r1,@dtdsec(r9)      mod + 1= desired sector
.
       mov  r0,r1               div = track no
       clr  r0
       div  @dt2hd(r8),r0     divide track no by no of heads
       mov  r0,@dtdtrk(r9)      div = desired track
       mov  r1,@dtdhed(r9)      mod = desired head
.
       c    r0,@dttksf(r8)    if desired track > tracks/surface
       jl   piop2
       li   r1,3                 get error code
       li   r2,0ff
       b    @failure          failure exit    
.
.
. ********************************************************************
. *                  READ / WRITE ROUTINE                            *
. ********************************************************************
.
piop2
       mov  @dtoml(r9),@dtmeml(r9)      # bytes to transfer
       mov  @dtoma(r9),@dtmema(r9)      to/from which address
       mov  @dttmp1(r9),r1    if sector offset <> 0 then transfer partial
       jeq  piop3
.
.         starting section may not start on a physical sector boundary.
.         this section allows for transfer of a partial sector.
.
       bl   @read             read sector
.                             set pointer into buffer
       mov  @dttmp1(r9),r2    offset=#sectors*128, (seclen=128)
       sla  r2,7                   
       ai   r2,savbuf         + buffer address=source address
.
       mov  @dtmema(r9),r1    get user mem pointer=destination address
       li   r3,savbuf         calc end of int buff
       a    dtbtsc(r8),r3
.
       mov  @dtcfun(r9),r0    do read or write actions
       ci   r0,w$
       jeq  piop4
.                                 
piop5  .                      read action
       mov  *r2+,*r1+         move buffer data to user
       dect @dtmeml(r9)       decr byte count
       jeq  piop5x            until required length done
       c    r2,r3             or buffer is exhausted
       jl   piop5
piop5x
       mov  r1,@dtmema(r9)    set new starting memory address
       jmp  piop6
.                                 
piop4
       mov  *r1+,*r2+         move user data to buffer
       dect @dtmeml(r9)       decr byte count
       jeq  piop4x            until all transferred
       c    r2,r3             or end of internal buffer
       jl   piop4
piop4x
       mov  r1,@dtmema(r9)    set new starting memory address
       bl   @write            write back sector
.                             
piop6
       bl   @nxtsec           set next sector address
.
.
.         Now process all the complete physical sectors
.
piop3
piop8
       c    @dtmeml(r9),@dtbtsc(r8)  more than a complete sector to go?
       jl   piop9                    no, so quit reading whole sectors
       mov  @dtcfun(r9),r0    check for read or write required
       ci   r0,w$
       jeq  piop10
.                             read action
       bl   @read             read sector
       li   r0,savbuf         source address
       mov  @dtmema(r9),r1    destination address
       mov  @dtbtsc(r8),r2    count
       srl  r2,3              but move in eight byte blocks
piop8a
       mov  *r0+,*r1+         shift data
       mov  *r0+,*r1+
       mov  *r0+,*r1+
       mov  *r0+,*r1+
       dec  r2                till done
       jne  piop8a
       jmp  piop11              else
.
piop10
       mov  @dtmema(r9),r0    source address
       li   r1,savbuf         destination address
       mov  @dtbtsc(r8),r2    count
       srl  r2,3              in eight byte blocks
piop10a
       mov  *r0+,*r1+         shift data
       mov  *r0+,*r1+
       mov  *r0+,*r1+
       mov  *r0+,*r1+
       dec  r2                till done
       jne  piop10a
       bl   @write            write sector
.                               
piop11
       s    @dtbtsc(r8),@dtmeml(r9) reduce byte count by sector length
       a    @dtbtsc(r8),@dtmema(r9) update user pointer
       bl   @nxtsec           set next sector address
       jmp  piop8             go for next sector
.
.         The last section deals with transferring data that does not finish   
.         on a physical sector boundary.
.
piop9
       mov  @dtmeml(r9),r6    skip if byte count = 0
       jeq  piop15
.
       bl   @read             read complete sector into buffer
       mov  @dtcfun(r9),r0    check if read or write required
       ci   r0,w$
       jeq  piop13
.                             read
       li   r0,savbuf         source address
       mov  @dtmema(r9),r1    destination address
piop9a
       mov  *r0+,*r1+         shift data in eight byte blocks
       mov  *r0+,*r1+
       mov  *r0+,*r1+
       mov  *r0+,*r1+
       ai   r6,-8             till done
       jne  piop9a
       jmp  piop15            and get out
.
piop13
       li   r0,savbuf         merge user data into buffer
       mov  @dtmema(r9),r1
piop14
       mov  *r1+,*r0+         shift data in eight byte blocks till done
       mov  *r1+,*r0+
       mov  *r1+,*r0+
       mov  *r1+,*r0+
       ai   r6,-8
       jne  piop14
       bl   @write            write sector back
.                             
piop15
success
       clr  r1                sucessful status
       clr  r2
       jmp  piopexit

failure
       mov  @dtst0(r9),r2

piopexit
       popj                   return to caller
.
. ********************************************************************
.                  READ/WRITE SECTOR ROUTINE                         *
. ********************************************************************
. Read or write sector
. from or to unit no in dtselb(r8) (also defines physical sector size)
.            head no in dtdhed(r9)
.            track no in dtdtrk(r9)
.            sector no in dtdsec(r9)
. to or from savbuf
. no of bytes to transfer in dtbtsc(r8)
.
read
       pshr r11               save return address
.
       mov  @dtdhed(r9),r0    get head number
       sla  r0,8              into high byte
       socb @dtselb(r8),r0    add in drive select code
       movb r0,@wsdh(r12)     and send to controller
.
       mov  @dtdsec(r9),r0    fetch required sector
       mov  @dtprct(r8),r2    is precession table active?
       jeq  noskewr           no, skip this bit
       a    r0,r2             add sector number to table base address
       movb *r2,r0            fetch skewed sector 
       srl  r0,8              and align in low byte
noskewr     
       swpb r0                get sector number in high byte
       movb r0,@wsecn(r12)    and transfer to controller
       mov  @dtdtrk(r9),r0    get track number
       swpb r0
       movb r0,@wcyll(r12)    set low part
       swpb r0
       movb r0,@wcylh(r12)    and high part
.
       li   r0,readcom        send read command
       bl   @setcom
       bl   @status           wait for completion
       andi r0,errst          check error bit in r0
       jne  readbad           no, take error exit
readgood
       mov  @dtbtsc(r8),r1    get no of bytes to xfer
       li   r0,savbuf         get memory address
reads2
       movb @rdata(r12),*r0+  move data to buffer
       dec  r1     
       jne  reads2
       popj                   and return
.
readbad
writebad
.
       li   r1,1              set error code
       dect r10               pop return from READ/WRITE
       b    @failure
.
write
       pshr r11               stack return address
       mov  @dtdsec(r9),r0    fetch required sector
       mov  @dtprct(r8),r2    is precession table active?
       jeq  noskeww           no, skip this bit
       a    r0,r2             add sector number to table base address
       movb *r2,r0            fetch skewed sector 
       srl  r0,8              and align in low byte
noskeww     
       swpb r0                get sector number in high byte
       movb r0,@wsecn(r12)    and transfer to controller
       mov  @dtdhed(r9),r0    get head number
       sla  r0,8              into high byte
       socb @dtselb(r8),r0    add in drive select code
       movb r0,@wsdh(r12)     and send to controller
.      li   r0,0ff00          turn write precomp off
.      movb r0,@wpcr(r12)
       mov  @dtdtrk(r9),r0    get track number
       swpb r0
       movb r0,@wcyll(r12)    set low part
       swpb r0
       movb r0,@wcylh(r12)    and high part
.
dowrite    
       li   r0,writcom        set write command
       bl   @setcom           issue it
.
writs1
.      li   r0,020
.      dec  r0
.      jne  $-2
.      movb @rstat(r12),r0    wait for drq status
.      andi r0,drqst
.      jeq  writs1
.
       mov  @dtbtsc(r8),r1    fetch of bytes to xfer
       li   r0,savbuf         get memory address
writs2
       movb *r0+,@wdata(r12)  move data to controller
       dec  r1
       jne  writs2
writs3
       bl   @status           wait for comand completion
       andi r0,errst          isolate error status bit
       jne  writebad          if set, error exit
       popj                   and return
.
.      STATUS waits for a current command to complete,
.      and returns the error status in the high byte of r0.
.
status
status1lp
       movb @rstat(r12),r0    fetch byte
       andi r0,busyst         mask out busy bit
       jne  status1lp         spin while busy
.
       movb @rstat(r12),r0
       nop
       movb @rerr(r12),r1     get error status
       srl  r1,8              align
       mov  r1,@dtst0(r9)     stash
       jeq  status2           skip if no error bits set
       ori  r0,errst          if ANY bit in error reg set, set error status
status2
       rt
.
.         setcom - waits a bit and then sets the command
.         the command code is passed in the high byte of r0
.
setcom
          movb      r0,@wcmd(r12)
          rt
.
.      set next sector address
.
nxtsec
       inc  @dtdsec(r9)                 incr desired sector
       c    @dtdsec(r9),@dtsctk(r8)     if sector 0 sector/track
       jle  nxt1
       li   r0,1                        set sector 1
       mov  r0,@dtdsec(r9)
       inc  @dtdhed(r9)                 select next head
       c    @dtdhed(r9),@dt2hd(r8)      if head no 0= no of heads
       jl   nxt1
       clr  @dtdhed(r9)                 clr head no
       inc  @dtdtrk(r9)                 next track
       c    @dtdtrk(r9),@dttksf(r8)     if track no 0= no of tracks
       jl   nxt1
.
       li   r1,3                        set error code
       b    @failure                    error exit                       
nxt1
       rt
.
          page
.
.      BUFFERS
.
stack     bss       32
.
savbuf    bss       0100 
          data      055aa
.
         end
